# M55M1 register map
File version: 1.0
Registers are 32-bit, read-write, reset 0x0 unless marked. A register's access mark holds for its fields unless they carry their own. Offsets are from the block's base; [hi:lo] are bit positions; {n}, {i} and the like mark numbered series.

## NPU — NPU Register Map
Base 0x40003000
0x00 ID ro reset 0x10104201
0x04 STATUS ro reset 0x8 — Register describes the current operating status of the NPU
0x08 CMD reset 0xC — Command register, reads as last written command
0x0C RESET — Request Reset and new security modeIf this register is written to by a permitted manager, then the NPU is reset (clearing all internal RAMs) and the reset register value is updated. (Otherwise the write to this register is ignored and the NPU is not reset.) The value written to this register sets the privilege level used by the NPU when the NPU acts as an AXI manager. The host is permitted to set any level of privilege less than or equal to the host privilege level.
0x10 QBASE0 — Base address of Command-queue bits[31:0]. The address is 4-byte-aligned
0x14 QBASE1 — Address extension bits[47:32] for queue base
0x18 QREAD ro — Read offset in the command stream in bytes. Multiples of 4 in the range 0-16 Mbytes
0x1C QCONFIG — AXI configuration for the command stream in the range 0-3. Same encoding as for REGIONCFG
0x20 QSIZE — Size of the command stream in bytes.Multiples of 4 in the range 0-16 Mbytes
0x24 PROT ro — Protection level configured for the NPU when acting as an AXI master
0x28 CONFIG ro reset 0x3008 — RTL configuration
0x2C LOCK — Lock register. This register is designed for driver use and does not affect NPU functionality
0x3C REGIONCFG — Base pointer configuration. Bits[2*k+1:2*k] give the memory type for REGION[k]
0x40 AXI_LIMIT0 — AXI limits for port 0 counter 0
0x44 AXI_LIMIT1 — AXI limits for port 0 counter 1
0x48 AXI_LIMIT2 — AXI limits for port 1 counter 2
0x4C AXI_LIMIT3 — AXI limits for port 1 counter 3
0x80 BASEP0 — Lower 32 bits of the Base pointer for region index 0
0x84 BASEP1 — Upper 32 bits of the Base pointer for region index 0
0x88 BASEP2 — Lower 32 bits of the Base pointer for region index 1
0x8C BASEP3 — Upper 32 bits of the Base pointer for region index 1
0x90 BASEP4 — Lower 32 bits of the Base pointer for region index 2
0x94 BASEP5 — Upper 32 bits of the Base pointer for region index 2
0x98 BASEP6 — Lower 32 bits of the Base pointer for region index 3
0x9C BASEP7 — Upper 32 bits of the Base pointer for region index 3
0xA0 BASEP8 — Lower 32 bits of the Base pointer for region index 4
0xA4 BASEP9 — Upper 32 bits of the Base pointer for region index 4
0xA8 BASEP10 — Lower 32 bits of the Base pointer for region index 5
0xAC BASEP11 — Upper 32 bits of the Base pointer for region index 5
0xB0 BASEP12 — Lower 32 bits of the Base pointer for region index 6
0xB4 BASEP13 — Upper 32 bits of the Base pointer for region index 6
0xB8 BASEP14 — Lower 32 bits of the Base pointer for region index 7
0xBC BASEP15 — Upper 32 bits of the Base pointer for region index 7
0x180 PMCR reset 0x2000 — PMU master control register
0x184 PMCNTENSET — Count-enable set register
0x188 PMCNTENCLR — Count-enable clear register
0x18C PMOVSSET — Overflow-flag status set register
0x190 PMOVSCLR — Overflow-flag status clear register
0x194 PMINTSET — Interrupt-enable set register
0x198 PMINTCLR — Interrupt-enable clear register
0x1A0 PMCCNTR_LO — Performance-monitor cycle count low register
0x1A4 PMCCNTR_HI — Performance-monitor cycle count high register
0x1AC PMCAXI_CHAN — Set which AXI channel monitor
0x300 PMU_EVCNTRn — Performance-monitor event counters
0x380 PMU_EVTYPERn — Performance-monitor event-type control counters
0xFD0 PID4 ro reset 0x4 — Peripheral ID byte 4 (Arm=code 4)
{0xFC0+4i} PID{i} ro (i=5..7) — Peripheral ID byte {i} (reserved)
0xFE0 PID0 ro reset 0x80 — Peripheral ID byte 0. This is bits[7:0] of the part number.
0xFE4 PID1 ro reset 0xB5 — Peripheral ID byte 1. This is bits[11:8] of the part number in bits[3:0], and bits[3:0] of the Arm ID in bits[7:4].
0xFE8 PID2 ro reset 0xB — Peripheral ID byte 2. This is bits[6:4] of the Arm ID in bits[2:0], and bit 3 indicates format B.
0xFEC PID3 ro — Peripheral ID byte 3.
0xFF0 CID0 ro reset 0xD — Component ID byte 0.
0xFF4 CID1 ro reset 0xF0 — Component ID byte 1.
0xFF8 CID2 ro reset 0x5 — Component ID byte 2.
0xFFC CID3 ro reset 0xB1 — Component ID byte 3.
