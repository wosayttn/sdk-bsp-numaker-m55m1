## board/Kconfig
```kconfig
menu "Hardware Drivers Config"

    menu "On-chip Peripheral Drivers"
        source "./libraries/m5531/rtt_port/Kconfig"
    endmenu

    menu "On-board Peripheral Drivers"

        config BSP_USING_NULINKME
            bool "Enable UART0 for RTT Console(uart0)"
            select BSP_USING_UART
            select BSP_USING_UART0
            default y

        config BOARD_USING_DIGITAL_MICROPHONE
            bool "DIGITAL Microphone supporting(over dmic0)"
            select BSP_USING_DMIC
            select BSP_USING_DMIC0
            select DMIC_ENABLE_CHANNEL_AT_STARTUP
            default n

        config BOARD_USING_RTL8201FI
            bool "Enable Ethernet phy supporting(over emac/mdio)"
            select BSP_USING_EMAC
            default n

        config BOARD_USING_ESP8266
            bool "ESP8266 Wi-Fi module supporting(over uart8)"
            select BSP_USING_UART
            select BSP_USING_UART8
            select PKG_USING_AT_DEVICE
            select AT_DEVICE_USING_ESP8266
            select AT_DEVICE_ESP8266_INIT_ASYN
            default y

        config BOARD_USING_NAU8822
            bool "NAU8822 Audio Codec supporting(over i2s0, i2c2)"
            select NU_PKG_USING_NAU8822
            select BSP_USING_I2C3
            select BSP_USING_I2S
            select BSP_USING_I2S0
            default n

        config BOARD_USING_STORAGE_SDCARD
            bool "SDCARD supporting(over sdh0)"
            select BSP_USING_SDH
            select BSP_USING_SDH0
            default n

        config BOARD_USING_CANFD0
            bool "CAN-FD supporting(over canfd0)"
            select BSP_USING_CANFD
            select BSP_USING_CANFD0
            default y

        config BOARD_USING_EXTERNAL_HYPERRAM
            bool "External HyperRAM supporting(over spim0)"
            select BSP_USING_SPIM
            select BSP_USING_SPIM0
            default y

        if BOARD_USING_EXTERNAL_HYPERRAM
            config BOARD_USING_HYPERRAM_SIZE
                int "How many HyperRAM capacity in bytes"
                range 8388608 33554432
                default 8388608
        endif

        config BOARD_USING_MPU6500
            bool "MPU6500 6-axis MotionTracking Sensor(over lpi2c0)"
            select PKG_USING_MPU6XXX
            select PKG_USING_MPU6XXX_LATEST_VERSION
            select PKG_USING_MPU6XXX_ACCE
	        select RT_USING_SENSOR
            select BSP_USING_LPI2C
            select BSP_USING_LPI2C0
            default y

    endmenu

    menu "Board extended module drivers"

    choice
        prompt "Use LCD Panel"

        config BOARD_USING_LCD_NONE
            bool "None"

        config BOARD_USING_LCD_LT7381
            bool "LCD LT7381(over ebi0)"
            select NU_PKG_USING_LT7381
            select NU_PKG_USING_LT7381_EBI
            select NU_PKG_LT7381_WITH_OFFSCREEN_FRAMEBUFFER

        config BOARD_USING_LCD_FSA506
            bool "LCD FSA506(over ebi0)"
            select NU_PKG_USING_FSA506
            select NU_PKG_USING_FSA506_EBI
            select NU_PKG_FSA506_WITH_OFFSCREEN_FRAMEBUFFER

    endchoice

    if BOARD_USING_LCD_LT7381

        config BOARD_USING_LT7381_EBI_PORT
        int "Specify EBI port index"
        range 0 2
        default 0

        config BOARD_USING_LT7381_PIN_BACKLIGHT
        int "Specify the pin index of backlight pin index"
            range 0 127
            default 101

        config BOARD_USING_LT7381_PIN_RESET
        int "Specify the pin index of reset pin index"
            range 0 127
            default 118

        config BOARD_USING_LT7381_PIN_DISPLAY
        int "Specify the pin index of display-on"
            range 0 127
            default 112

    config BOARD_USING_FT5446
        bool "TPC FT5446(over i2c1)"
        select BSP_USING_I2C1
        select NU_PKG_USING_TPC
        select NU_PKG_USING_TPC_FT5446
        default y

    endif

    if BOARD_USING_LCD_FSA506

        config BOARD_USING_FSA506_EBI_PORT
        int "Specify EBI port index"
        range 0 2
        default 0

        config BOARD_USING_FSA506_PIN_BACKLIGHT
        int "Specify the pin index of backlight pin index"
            range 0 127
            default 101

        config BOARD_USING_FSA506_PIN_RESET
        int "Specify the pin index of reset pin index"
            range 0 127
            default 118

        config BOARD_USING_FSA506_PIN_DISPLAY
        int "Specify the pin index of display-on"
            range 0 127
            default 112

        config BOARD_USING_ST1663I
            bool "TPC ST1663I(over i2c1)"
            select BSP_USING_I2C1
            select NU_PKG_USING_TPC
            select NU_PKG_USING_TPC_ST1663I
            default y
    endif

    config BOARD_USING_SENSOR0
        bool "CCAP-SENSOR PORT0(over i2c0/PG11/PD12)"
        select BSP_USING_I2C
        select BSP_USING_I2C0
        select BSP_USING_CCAP
        select BSP_USING_CCAP0
        default n

        if BOARD_USING_SENSOR0
            config BOARD_USING_SENSON0_ID
                int "Specify Sensor0 ID"
                default 0
                range 0 3
                help
                    HM1055=0
                    ADV728X=1
        endif

    endmenu

    source "./libraries/nu_packages/Kconfig"

endmenu
```

## libraries/nu_packages/Kconfig
```kconfig
menu "Nuvoton Packages Config"
    config NU_PKG_USING_UTILS
        bool
        default y

    config NU_PKG_USING_DEMO
        bool "Enable demos"
        default y

    config NU_PKG_USING_BMX055
        bool "BMX055 9-axis sensor."
        select RT_USING_I2C
        select RT_USING_SENSOR
        default n

    config NU_PKG_USING_MAX31875
        bool "MAX31875 Temperature sensor."
        select RT_USING_I2C
        select RT_USING_SENSOR
        default n

    config NU_PKG_USING_NCT7717U
        bool "NCT7717U Temperature sensor."
        select RT_USING_I2C
        select RT_USING_SENSOR
        default n

    config NU_PKG_USING_TMP112
        bool "TMP112 Temperature sensor."
        select RT_USING_I2C
        select RT_USING_SENSOR
        default n

    config NU_PKG_USING_LIS3DH
        bool "LIS3DH 3-AXIS Accelerator sensor."
        select RT_USING_I2C
        select RT_USING_SENSOR
        default n

    config NU_PKG_USING_LPS22HH
        bool "LPS22HH Barometer sensor."
        select RT_USING_I2C
        select RT_USING_SENSOR
        default n

    config NU_PKG_USING_NAU88L25
        bool "NAU88L25 Audio Codec."
        select BSP_USING_I2C
        default n

    config NU_PKG_USING_NAU8822
        bool "NAU8822 Audio Codec."
        select BSP_USING_I2C
        default n

    config NU_PKG_USING_DA9062
        bool "DA9062 PMIC."
        select BSP_USING_I2C
        default n

    config NU_PKG_USING_ILI9341
        bool "ILI9341 LCD Panel"
        select BSP_USING_GPIO
        default n

        if NU_PKG_USING_ILI9341

            choice
                prompt "Select ili9341 interface"

                config NU_PKG_USING_ILI9341_SPI
                    select BSP_USING_SPI
                    bool "ILI9341_SPI"
                help
                    Choose this option if you the ili9341 device is with SPI interface.

                config NU_PKG_USING_ILI9341_EBI
                    select BSP_USING_EBI
                    bool "ILI9341_EBI"
                help
                    Choose this option if you the ili9341 device is with EBI interface.
            endchoice

            if NU_PKG_USING_ILI9341_SPI
                config NU_PKG_USING_ILI9341_SPI_CLK_FREQ
                    int "Set SPI Clock frequency"
                    default 48000000
            endif

            config NU_PKG_ILI9341_WITH_OFFSCREEN_FRAMEBUFFER
                bool "Create an offscreen framebuffer."
                default n

            if NU_PKG_ILI9341_WITH_OFFSCREEN_FRAMEBUFFER
                config NU_PKG_ILI9341_LINE_BUFFER_NUMBER
                    int "Allocate Line buffer number."
                    range 1 240
                    default 240
            endif

            config NU_PKG_ILI9341_HORIZONTAL
                bool
                default y


            config BSP_LCD_BPP
                int
                default 16     if NU_PKG_USING_ILI9341

            config BSP_LCD_WIDTH
                int
                default 320    if NU_PKG_ILI9341_HORIZONTAL

            config BSP_LCD_HEIGHT
                int
                default 240    if NU_PKG_ILI9341_HORIZONTAL

        endif


    config NU_PKG_USING_SSD1963
        bool "SSD1963 LCD Panel"
        select BSP_USING_GPIO
        default n

        if NU_PKG_USING_SSD1963

            choice
                prompt "Select SSD1963 interface"

                config NU_PKG_USING_SSD1963_EBI
                    select BSP_USING_EBI
                    bool "SSD1963_EBI"
                help
                    Choose this option if you the SSD1963 device is with EBI interface.
            endchoice

            config NU_PKG_SSD1963_WITH_OFFSCREEN_FRAMEBUFFER
                bool "Create an offscreen framebuffer."
                default n

            if NU_PKG_SSD1963_WITH_OFFSCREEN_FRAMEBUFFER
                config NU_PKG_SSD1963_LINE_BUFFER_NUMBER
                    int "Allocate Line buffer number."
                    range 16 272
                    default  272
            endif

            config BSP_LCD_BPP
                int
                default 16     if NU_PKG_USING_SSD1963

            config BSP_LCD_WIDTH
                int
                default 480    if NU_PKG_USING_SSD1963

            config BSP_LCD_HEIGHT
                int
                default 272    if NU_PKG_USING_SSD1963

        endif

    config NU_PKG_USING_FSA506
        bool "FSA506 LCD Panel"
        select BSP_USING_GPIO
        default n

        if NU_PKG_USING_FSA506

            choice
                prompt "Select FSA506 interface"

                config NU_PKG_USING_FSA506_EBI
                    select BSP_USING_EBI
                    bool "FSA506_EBI"
                help
                    Choose this option if you the FSA506 device is with EBI interface.
            endchoice

            config NU_PKG_FSA506_WITH_OFFSCREEN_FRAMEBUFFER
                bool "Create an offscreen framebuffer."
                default n

            if NU_PKG_FSA506_WITH_OFFSCREEN_FRAMEBUFFER
                config NU_PKG_FSA506_LINE_BUFFER_NUMBER
                    int "Allocate Line buffer number."
                    range 16 272
                    default  272
            endif

            config BSP_LCD_BPP
                int
                default 16     if NU_PKG_USING_FSA506

            config BSP_LCD_WIDTH
                int
                default 480    if NU_PKG_USING_FSA506

            config BSP_LCD_HEIGHT
                int
                default 272    if NU_PKG_USING_FSA506

        endif

    config NU_PKG_USING_LT7381
        bool "LT7381 LCD Panel"
        select BSP_USING_GPIO
        default n

        if NU_PKG_USING_LT7381

            choice
                prompt "Select LT7381 interface"

                config NU_PKG_USING_LT7381_EBI
                    select BSP_USING_EBI
                    bool "LT7381_EBI"
                help
                    Choose this option if you the LT7381 device is with EBI interface.
            endchoice

            config NU_PKG_LT7381_WITH_OFFSCREEN_FRAMEBUFFER
                bool "Create an offscreen framebuffer."
                default n

            if NU_PKG_LT7381_WITH_OFFSCREEN_FRAMEBUFFER
                config NU_PKG_LT7381_LINE_BUFFER_NUMBER
                    int "Allocate Line buffer number."
                    range 16 480
                    default  480
            endif

            config BSP_LCD_BPP
                int
                default 16     if NU_PKG_USING_LT7381

            config BSP_LCD_WIDTH
                int
                default 800    if NU_PKG_USING_LT7381

            config BSP_LCD_HEIGHT
                int
                default 480    if NU_PKG_USING_LT7381

        endif

    if BSP_USING_EBI
        config NU_PKG_EBI_I80_CMD
            hex "EBI I80 Command offset"
            default 0x0

        config NU_PKG_EBI_I80_DATA
            hex "EBI I80 Data offset"
            default 0x0
    endif

    config NU_PKG_USING_TPC
        bool "Support Touch Panel Controller over I2C"
        select RT_USING_TOUCH
        select RT_TOUCH_PIN_IRQ
        select RT_USING_I2C

    if NU_PKG_USING_TPC
        choice
            prompt "Select TPC drivers"
            config NU_PKG_USING_TPC_ILI
                bool "ILI Series TPC"

            config NU_PKG_USING_TPC_GT911
                bool "GT911 TPC"

            config NU_PKG_USING_TPC_FT5446
                bool "FT5446 TPC"

            config NU_PKG_USING_TPC_ST1663I
                bool "ST1663I TPC"

        endchoice

        config NU_PKG_TPC_REVERSE_XY
            bool "Reverse X-Y coordinate"
            default n

    endif

    config NU_PKG_USING_ADC_TOUCH
        bool "ADC touch function"
        select RT_USING_TOUCH
        default n

    if NU_PKG_USING_ADC_TOUCH
        choice
            prompt "Select TPC drivers"

        config NU_PKG_USING_ADC_TOUCH_HW
            bool "Using HW ADC touch"

        config NU_PKG_USING_ADC_TOUCH_SW
            bool "Using SW ADC touch"
            select RT_USING_ADC

        config NU_PKG_USING_ADC_TOUCH_SERIAL
            bool "Serial touch function"
            select RT_USING_SERIAL

        endchoice

        if NU_PKG_USING_ADC_TOUCH_SERIAL
            config NU_PKG_SERIAL_TOUCH_DEVNAME
                string "uart1"
                default "uart1"
        endif
    endif

    config NU_PKG_USING_SPINAND
        bool "SPI NAND flash."
        select BSP_USING_QSPI
        select RT_USING_MTD_NAND
        default n

    config NU_PKG_USING_RV3032C7
        bool "Using RV3032-C7 RTC."
        select RT_USING_RTC
        default n

    if BSP_USING_DISP

        config NU_PKG_USING_DISPLIB
            bool "DISP Converter"
            select BSP_USING_GPIO
            select BSP_USING_I2C

        if NU_PKG_USING_DISPLIB
            choice
                prompt "Select one DISP converter"

                config NU_PKG_USING_DISPLIB_LT8918
                    bool "RGB to MIPI(LT8918)"
                    help
                    Choose this option if you the LT8918 device.

                config NU_PKG_USING_DISPLIB_LT8618
                    bool "RGB to HDMI(LT8618)"
                    help
                    Choose this option if you the LT8618 device.

                config NU_PKG_USING_DISPLIB_LT8718
                    bool "RGB to eDP(LT8718)"
                    help
                    Choose this option if you the LT8718 device.
            endchoice

            config NU_PKG_USING_DISPLIB_I2C_DEVNAME
                string "Specify I2C Name"
                select RT_USING_I2C
                default "i2c1"
                help
                    Specify I2C device name.

            config NU_PKG_USING_DISPLIB_RST_IDXNUM
                int "Specify Rst Pin Index Number"
                select RT_USING_PIN
                default 204
                help
                    Specify Reset Pin Index Number(Default: PM12).
        endif
    endif

endmenu
```
